;
; DA2PART2ASSEMBLY.asm
;
; Created: 3/20/2025 5:06:26 PM
; Author : Carlos Funes
;


; Replace with your application code
.INCLUDE <M328PBDEF.INC> 

.ORG 0 ;RESET LOCATION
     JMP MAIN ;JUMPING TO MAIN

.ORG 0x02 ;INT0 VECTOR
JMP ISR_INT0VECTOR

DELAY_150MS:        ;DELAY SUBROUTINE
	LDI R17, 0x30 ;THIS IS OUTER LOOP
L1:
    LDI R18, 0x40 ;MIDDLE LOOP
L2:
	LDI R19, 0x60 ;INNER LOOP
L3: 
	DEC	R19 ;DECREMENTING R19
	CPI R19, 0 ;
	BRNE L3 ;BRANCH TO L3 IF R19 /= 0
	DEC R18 ;DECREMENTING R18
	CPI R18, 0
	BRNE L2 ;BRANCH TO L2 IF R18 /= 0 
	DEC R17 ;DECREMENTING R17
	CPI R17, 0
	BRNE L1 ;BRANCH TO L1 IF R17 /= 0
	RET	;RETURN TO THE PROGRAM
MAIN:
    LDI R20, HIGH(RAMEND) ;STARTING STACK POINTER
    OUT SPH, R20
    LDI R20, LOW(RAMEND)
    OUT SPL, R20

	LDI R20, 0x03 ;MAKING INT0 BE TRIGGERED AT RISING EDGE, LAST 2 BITS MAKE THIS HAPPEN
	STS EICRA, R20 ;STORING R20 INTO EICRA
	SBI EIMSK, INT0 ;ENABLING INT0 INTERRUPT
	SEI

    SBI DDRB, 5 ;PORTB5 AS OUTPUT
    CBI PORTB, 5 ;PORTB5 INITIALIZED TO OFF        
    CBI DDRD, 2 ; PORTD2 AS INPUT        
    SBI PORTD, 2 ;ENABLING PULL UP RESISTORS FOR PUSHBUTTON

WHILE:
    CBI PORTB, 5 ;LED IS OFF WHILE IN THE LOOP
	RJMP WHILE ;LOOP FOREVER          
          

ISR_INT0VECTOR:
    SBI PORTB, 5 ;TURN ON PB5 LED
    LDI R16, 0x14 ;1.5 SECOND DELAY 
	LJ:
		CALL DELAY_150MS ;CALLING DELAY SUBROUTINE
		DEC R16 ;DECREMENT R16
		CPI R16, 0 ;CHECK IF R16 = 0
		BRNE LJ ;CONTINUE TO LOOP IF R16 /= 0
	CBI PORTB, 5 ;AFTER 1.5 SECONDS, TURN OFF LED 
	RETI ;RETURNING FROM INTERRUPT
